## example/CrowPanel_Advance_ESP32-P4 Display_Firmware_Upgrade_Guide/host_performs_slave_ota/sdkconfig.defaults
```kconfig
# Default configuration for Host Slave OTA Simple Example

# Flash size configuration
CONFIG_ESPTOOLPY_FLASHSIZE_8MB=y
CONFIG_ESPTOOLPY_FLASHSIZE="8MB"

# Force enable ESP-Hosted component
CONFIG_ESP_WIFI_REMOTE_ENABLED=y
CONFIG_ESP_HOSTED_ENABLED=y

# FreeRTOS configuration
CONFIG_FREERTOS_HZ=1000

# Partition table
CONFIG_PARTITION_TABLE_CUSTOM=y
CONFIG_PARTITION_TABLE_CUSTOM_FILENAME="partitions.csv"
CONFIG_PARTITION_TABLE_FILENAME="partitions.csv"

# P4 chip version select
CONFIG_ESP32P4_SELECTS_REV_LESS_V3=y

# Host Slave OTA config
CONFIG_OTA_METHOD_LITTLEFS=y

# Hosted slave config
CONFIG_ESP_HOSTED_SDIO_1_BIT_BUS=y
CONFIG_ESP_HOSTED_SDIO_BUS_WIDTH=1
CONFIG_ESP_HOSTED_SDIO_CLOCK_FREQ_KHZ=40000
CONFIG_ESP_HOSTED_PRIV_SDIO_PIN_CMD_SLOT_1=19
CONFIG_ESP_HOSTED_PRIV_SDIO_PIN_CLK_SLOT_1=18
CONFIG_ESP_HOSTED_PRIV_SDIO_PIN_D0_SLOT_1=14
CONFIG_ESP_HOSTED_PRIV_SDIO_PIN_D1_1BIT_BUS_SLOT_1=15
CONFIG_ESP_HOSTED_SDIO_GPIO_RESET_SLAVE=32
```
